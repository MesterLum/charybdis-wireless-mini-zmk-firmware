#include <input/processors.dtsi>
#include <dt-bindings/zmk/input_transform.h>

&trackball_listener {
    /* base processor chain on all layers */
    /* 1:4 at cpi=3200 -> 800 effective CPI (1067 was still hard to aim with).
       Speed lives HERE, smoothness lives in cpi. The sensor keeps producing
       3200-CPI steps and the scaler carries remainders, so dividing down costs
       no counts and no granularity - only travel distance.
       Other options:  1 2 -> 1600   2 5 -> 1280   3 4 -> 2400   5 5 -> 3200
       Never lower cpi to slow the pointer - that is what costs smoothness. */
    input-processors = <&zip_xy_scaler 1 4>;

    /* MOUSE is layer 4 and deliberately has NO override here: the ball keeps
       using the base chain above, so you can still aim while the clicks on
       that layer are reachable. SLOW (5) and SCROLL (6) hang off it.
       Only ONE of these may be active at a time - when two overrides match
       the first one declared wins, which is what silently broke SLOW when it
       was nested inside SCROLL. */

    /* SCROLL layer (index 6) - ball becomes a scroll wheel */
    scroller: scroller {
        layers           = <6>;   // SCROLL - keep in sync with the keymap
        input-processors = <
            &zip_xy_scaler 1 120                             // Scales the scroll speed
            &zip_xy_to_scroll_mapper                         // Converts XY movement to scroll events
            &zip_scroll_transform (INPUT_TRANSFORM_Y_INVERT) // Inverts the scroll direction
        >;
    };

    /* SLOW layer (index 5) - precision pointer, ~267 effective CPI */
    slow_pointer: slow_pointer {
        layers           = <5>;   // SLOW - keep in sync with the keymap
        input-processors = <&zip_xy_scaler 2 24>;
    };
};
